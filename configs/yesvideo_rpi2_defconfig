## configs/yesvideo_rpi2_defconfig
```kconfig
BR2_arm=y
BR2_cortex_a7=y
BR2_ARM_EABIHF=y
BR2_ARM_FPU_NEON_VFPV4=y
BR2_DEFCONFIG="/home/achoi/rpi-buildroot/configs/raspberrypi2_defconfig"
BR2_KERNEL_HEADERS_VERSION=y
BR2_DEFAULT_KERNEL_VERSION="4.0.1"
BR2_PACKAGE_HOST_LINUX_HEADERS_CUSTOM_4_0=y
BR2_TOOLCHAIN_BUILDROOT_WCHAR=y
BR2_TOOLCHAIN_BUILDROOT_CXX=y
BR2_TARGET_GENERIC_HOSTNAME="ufo"
BR2_TARGET_GENERIC_ISSUE=""
BR2_ROOTFS_DEVICE_CREATION_DYNAMIC_MDEV=y
BR2_ROOTFS_SKELETON_CUSTOM=y
BR2_ROOTFS_SKELETON_CUSTOM_PATH="board/raspberrypi/skeleton"
BR2_ROOTFS_OVERLAY="board/yesvideo/raspberrypi/rootfs-overlay"
BR2_LINUX_KERNEL=y
BR2_LINUX_KERNEL_CUSTOM_GIT=y
BR2_LINUX_KERNEL_CUSTOM_REPO_URL="git://github.com/raspberrypi/linux.git"
BR2_LINUX_KERNEL_CUSTOM_REPO_VERSION="rpi-4.0.y"
BR2_LINUX_KERNEL_USE_CUSTOM_CONFIG=y
BR2_LINUX_KERNEL_CUSTOM_CONFIG_FILE="configs/yesvideo_rpi2_linux_defconfig"
BR2_LINUX_KERNEL_ZIMAGE=y
BR2_PACKAGE_BUSYBOX_SHOW_OTHERS=y
BR2_PACKAGE_PI_BLASTER=y
BR2_PACKAGE_RTL8188C_8192C_WPA_SUPPLICANT_HOSTAPD=y
BR2_PACKAGE_DOSFSTOOLS=y
BR2_PACKAGE_DOSFSTOOLS_FSCK_FAT=y
BR2_PACKAGE_RPI_FIRMWARE=y
BR2_PACKAGE_NODEJS=y
BR2_PACKAGE_NODEJS_NPM=y
BR2_PACKAGE_NODEJS_MODULES_ADDITIONAL="express forever rpi-gpio pi-blaster.js mkdir-recursive multer path-is-absolute nodejs-disks"
BR2_PACKAGE_LIBNL=y
BR2_PACKAGE_DHCP=y
BR2_PACKAGE_DHCP_SERVER=y
BR2_PACKAGE_DROPBEAR=y
BR2_PACKAGE_UTIL_LINUX=y
BR2_PACKAGE_UTIL_LINUX_BINARIES=y
BR2_PACKAGE_UTIL_LINUX_FSCK=y
```

## package/RTL8188C_8192C_wpa_supplicant_hostapd/Config.in
```kconfig
config BR2_PACKAGE_RTL8188C_8192C_wpa_supplicant_hostapd
	bool "Realtek hostapd"
	help
	  Realtek custom hostapd for 8188c/8192c chipsets

	  https://github.com/YesVideo/RTL8188C_8192C_wpa_supplicant_hostapd
```

## package/pi-blaster/Config.in
```kconfig
config BR2_PACKAGE_PI_BLASTER
	bool "pi-blaster"
	help
	  RaspberryPi support for PWM GPIO pins

	  https://github.com/YesVideo/pi-blaster
```
